/**
 * @cliArgs --board "/ti/boards/MSP_EXP432P401R" --product "simplelink_msp432p4_sdk@3.40.01.02"
 * @versions {"data":"2021010520","timestamp":"2021010520","tool":"1.7.0+1746","templates":null}
 */
const BOOSTXL_SHARP128 = scripting.addHardware("/ti/boards/boosterpacks/BOOSTXL-SHARP128");
const MSP430BOOST_SHARP96 = scripting.addHardware("/ti/boards/boosterpacks/MSP430BOOST-SHARP96");

/**
 * Import the modules used in this configuration.
 */
const Display   = scripting.addModule("/ti/display/Display", {}, false);
const Display1  = Display.addInstance();
const GPIO      = scripting.addModule("/ti/drivers/GPIO");
const GPIO1     = GPIO.addInstance();
const GPIO2     = GPIO.addInstance();
const GPIO3     = GPIO.addInstance();
const GPIO4     = GPIO.addInstance();
const GPIO5     = GPIO.addInstance();
const I2C       = scripting.addModule("/ti/drivers/I2C", {}, false);
const I2C1      = I2C.addInstance();
const I2C2      = I2C.addInstance();
const Power     = scripting.addModule("/ti/drivers/Power");
const RTOS      = scripting.addModule("/ti/drivers/RTOS");
const Watchdog  = scripting.addModule("/ti/drivers/Watchdog", {}, false);
const Watchdog1 = Watchdog.addInstance();

/**
 * Write custom configuration values to the imported modules.
 */
Display1.$name      = "CONFIG_Display_0";
Display1.$hardware  = system.deviceData.board.components.XDS110UART;
Display1.uart.$name = "CONFIG_UART_0";

GPIO1.$hardware = system.deviceData.board.components.LED1_RED;
GPIO1.$name     = "CONFIG_GPIO_LED_0";

GPIO2.$name           = "CONFIG_GPIO_0";
GPIO2.gpioPin.$assign = "boosterpack.11";

GPIO3.$name           = "CONFIG_GPIO_1";
GPIO3.gpioPin.$assign = "boosterpack.31";

GPIO4.$name           = "CONFIG_GPIO_2";
GPIO4.gpioPin.$assign = "boosterpack.3";

GPIO5.$name           = "CONFIG_GPIO_3";
GPIO5.gpioPin.$assign = "boosterpack.4";

I2C1.$name = "CONFIG_I2C_0";

I2C2.$name = "CONFIG_I2C_1";

Power.enablePolicy            = false;
Power.enablePerformanceLevels = false;
Power.performanceLevel3.$name = "ti_drivers_power_PowerMSP432PerfLevels0";
Power.performanceLevel2.$name = "ti_drivers_power_PowerMSP432PerfLevels1";
Power.performanceLevel1.$name = "ti_drivers_power_PowerMSP432PerfLevels2";
Power.performanceLevel0.$name = "ti_drivers_power_PowerMSP432PerfLevels3";

RTOS.name = "NoRTOS";

Watchdog1.$name = "CONFIG_WATCHDOG_0";

/**
 * Pinmux solution for unlocked pins/peripherals. This ensures that minor changes to the automatic solver in a future
 * version of the tool will not impact the pinmux you originally saw.  These lines can be completely deleted in order to
 * re-solve from scratch.
 */
Display1.uart.uart.$suggestSolution       = "EUSCI_A0";
Display1.uart.uart.txPin.$suggestSolution = "7";
Display1.uart.uart.rxPin.$suggestSolution = "6";
GPIO1.gpioPin.$suggestSolution            = "4";
I2C1.i2c.$suggestSolution                 = "EUSCI_B2";
I2C1.i2c.sdaPin.$suggestSolution          = "boosterpack.38";
I2C1.i2c.sclPin.$suggestSolution          = "boosterpack.34";
I2C2.i2c.$suggestSolution                 = "EUSCI_B1";
I2C2.i2c.sdaPin.$suggestSolution          = "boosterpack.10";
I2C2.i2c.sclPin.$suggestSolution          = "boosterpack.9";
RTOS.timer0.resource.$suggestSolution     = "Timer_A0";
Watchdog1.watchdog.$suggestSolution       = "WATCHDOG";
